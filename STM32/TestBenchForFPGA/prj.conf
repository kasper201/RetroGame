## CMakeLists.txt
```
# SPDX-License-Identifier: Apache-2.0

cmake_minimum_required(VERSION 3.20.0)
find_package(Zephyr REQUIRED HINTS $ENV{ZEPHYR_BASE})
set(DTS_OVERLAY_FILE ${CMAKE_SOURCE_DIR}/board/nucleo_f091rc.overlay)
project(TestBenchForFPGA)

FILE(GLOB app_sources src/*.c)
target_sources(app PRIVATE ${app_sources})

# Add the path to the directory containing the missing header file
include_directories(
    header/
    src/
)
```

## prj.conf
```kconfig
CONFIG_GPIO=y
CONFIG_SERIAL=y
CONFIG_UART_INTERRUPT_DRIVEN=y
CONFIG_STDOUT_CONSOLE=y
```

## boards/nucleo_f030r8.overlay
```dts
&usart1{
	pinctrl-0 = <&usart1_tx_pa9 &usart1_rx_pa10>;
	pinctrl-names = "default";
	current-speed = <230400>;
	status = "okay";
};

&usart2{
	pinctrl-0 = <&usart2_tx_pa2 &usart2_rx_pa3>;
	pinctrl-names = "default";
	current-speed = <115200>;
	status = "okay";
};

/ {
	aliases {
	usart = &usart1;
	};
};
```

## boards/nucleo_f091rc.overlay
```dts
&usart1{
	pinctrl-0 = <&usart1_tx_pa9 &usart1_rx_pa10>;
	pinctrl-names = "default";
	current-speed = <460800>;
	status = "okay";
};

&usart2{
	pinctrl-0 = <&usart2_tx_pa2 &usart2_rx_pa3>;
	pinctrl-names = "default";
	current-speed = <115200>;
	status = "okay";
};

/ {
	aliases {
	usart = &usart1;
	};
};
```

## src/main.c
```c
/*
 * Copyright (c) 2016 Open-RnD Sp. z o.o.
 * Copyright (c) 2020 Nordic Semiconductor ASA
 *
 * SPDX-License-Identifier: Apache-2.0
 *
 * Connect pin 2 to A14 and pin 8 to A15
 */

#include <zephyr/kernel.h>
#include <zephyr/device.h>
#include <zephyr/drivers/gpio.h>
#include <zephyr/sys/util.h>
#include <zephyr/sys/printk.h>
#include <inttypes.h>
#include <string.h>
#include <zephyr/drivers/uart.h>

#include "uart.h"
#include "main.h"

#define SLEEP_TIME_MS 10

/*
 * Get button configuration from the devicetree sw0 alias. This is mandatory.
 */
#define SW0_NODE DT_ALIAS(sw0)
#if !DT_NODE_HAS_STATUS(SW0_NODE, okay)
#error "Unsupported board: sw0 devicetree alias is not defined"
#endif
static const struct gpio_dt_spec button = GPIO_DT_SPEC_GET_OR(SW0_NODE, gpios,
															  {0});
static struct gpio_callback button_cb_data;

/*
 * The led0 devicetree alias is optional. If present, we'll use it
 * to turn on the LED whenever the button is pressed.
 */
static struct gpio_dt_spec led = GPIO_DT_SPEC_GET_OR(DT_ALIAS(led0), gpios,
													 {0});

void button_pressed(const struct device *dev, struct gpio_callback *cb,
					uint32_t pins)
{
	// printk("Button pressed at %" PRIu32 "\n", k_cycle_get_32());
}

int main(void)
{
	int ret;

	if (!gpio_is_ready_dt(&button))
	{
		printk("Error: button device %s is not ready\n",
			   button.port->name);
		return 0;
	}

	ret = gpio_pin_configure_dt(&button, GPIO_INPUT);
	if (ret != 0)
	{
		printk("Error %d: failed to configure %s pin %d\n",
			   ret, button.port->name, button.pin);
		return 0;
	}

	ret = gpio_pin_interrupt_configure_dt(&button,
										  GPIO_INT_EDGE_TO_ACTIVE);
	if (ret != 0)
	{
		printk("Error %d: failed to configure interrupt on %s pin %d\n",
			   ret, button.port->name, button.pin);
		return 0;
	}

	gpio_init_callback(&button_cb_data, button_pressed, BIT(button.pin));
	gpio_add_callback(button.port, &button_cb_data);
	printk("Set up button at %s pin %d\n", button.port->name, button.pin);

	//
	//  Mijn stuk!!!
	//

	uartSetup();

	// Variables
	unsigned char sendByte[2];
	struct bullet bullets[2];
	struct plant plants[2];
	struct robot robots[2];
	int shopSelector = 2;
	struct selector gardenSelector;

	gardenSelector.x = 1;
	gardenSelector.y = 2;

	bullets[0].x = 2;
	bullets[0].y = 1;

	bullets[1].x = 3;
	bullets[1].y = 2;

	plants[0].x = 3;
	plants[0].y = 2;
	plants[0].id = 4;

	plants[1].x = 2;
	plants[1].y = 1;
	plants[1].id = 3;

	robots[0].x = 4;
	robots[0].y = 2;
	robots[0].id = 1;

	robots[1].x = 2;
	robots[1].y = 1;
	robots[1].id = 3;

	int byte;
	unsigned char sendByteC;
	unsigned char sendByteA[3];
	printk("Start\n");
	while (1)
	{
		// Read when button pressed 1 when released 0
		int val = gpio_pin_get_dt(&button);

		int input = checkFromFpga();
		switch (input)
		{
		case 0:
			int geld = 300;
			unsigned char tussenin = geld;
			if( geld > 253)
			{
				tussenin = tussenin + 3;
			}
			sendByte[0] = 0x11;
			sendByte[1] = 0x44;
			print_uart(sendByte);
			printf("Send these bytes: %d %d\n", sendByte[0], sendByte[1]);
			sendByte[0] = 0xff;
			sendByte[1] = 0xfe;
			print_uart(sendByte);
			break;
		case 1:
			byte = robots[0].id * 16 + robots[0].y;
			sendByteC = byte;
			print_uart(&sendByteC);
			printf("Send these byte: %d\n", sendByteC);
			sendByte[0] = 0xff;
			sendByte[1] = 0xfe;
			print_uart(sendByte);
			break;
		case 2:
			byte = (plants[0].id * 40) + (plants[0].x * 5) + plants[0].y;
			sendByteC = byte;
			print_uart(&sendByteC);
			printf("Send these byte: %d\n", sendByteC);
			sendByte[0] = 0xff;
			sendByte[1] = 0xfe;
			print_uart(sendByte);
			break;
		case 3:
			int y1 = bullets[0].y;
			int y2 = bullets[1].y;
			int y = y1 * 16 + y2;
			sendByteA[0] = y;
			sendByteA[1] = bullets[0].x;
			sendByteA[2] = bullets[1].x;
			print_uart(sendByteA);
			printf("Send these bytes: %d %d %d\n", sendByteA[0], sendByteA[1], sendByteA[2]);
			sendByte[0] = 0xff;
			sendByte[1] = 0xfe;
			print_uart(sendByte);
			break;
		case 4:
			sendByteC = 0x0a;
			print_uart(&sendByteC);
			printf("Send these bytes: %d\n", sendByteC);
			sendByte[0] = 0xff;
			sendByte[1] = 0xfe;
			print_uart(sendByte);
			break;
		case 5:
			byte = (shopSelector * 40) + (gardenSelector.x * 5) + gardenSelector.y;
			sendByteC = byte;
			print_uart(&sendByteC);
			printf("Send these byte: %d\n", sendByteC);
			sendByte[0] = 0xff;
			sendByte[1] = 0xfe;
			print_uart(sendByte);
			break;
		default:
			break;
		}

		k_msleep(SLEEP_TIME_MS);
	}
	return 0;
}
```

## src/compc.c
```c
#include "uart.h"
#include "main.h"

#include <zephyr/kernel.h>
#include <zephyr/device.h>
#include <zephyr/drivers/uart.h>
#include <zephyr/sys/printk.h>
#include <stdbool.h>
#include <string.h>

#define MESSAGE_SIZE 200 // Defines the maximum size for the incoming string

// Reads input from the application and decides what to do with it
void readPc()
{
    char Message[MESSAGE_SIZE];
    k_msgq_get(&uart_msgq, &Message, K_NO_WAIT);
    k_msgq_cleanup(&uart_msgq);

    // Send out already existing groups
    if (strstr(Message, "connected"))
    {
        printk("Connection is established\n");
        k_msleep(3);
        k_msleep(3);
        // empties Message
        for (int i = 0; i < MESSAGE_SIZE; i++)
        {
            Message[i] = '0';
        }
    }

    for (int i = 0; i < MESSAGE_SIZE; i++)
    {
        Message[i] = ' ';
    }
    k_msgq_cleanup(&uart_msgq);
}
```

## src/compc.h
```c
#ifndef COMPC_H_
#define COMPC_H_

void readPc();

#endif //COMPC_H_
```

## src/mainGame.c
```c
#include <stdio.h>
#include <stdlib.h>
#include <stdint.h>

#define MAP_WIDTH 8
#define MAP_HEIGHT 5

struct Map
{
    uint8_t health;
    uint8_t damage;
    uint8_t defense;
    uint8_t speed;
    uint8_t type; // there are 4 major types. 0 is empty, 1 is non shooting plant, 2 is shooting plant, 3 is robot these are devided into subtypes.
    // for the plants, 1 is money plant, 2 is shooter plant, 3 is blocking plant and 4 is exploding plant.
    // for the robots, 1 is normal robot, 2 is tank robot and 3 is flying robot.
};

int mapinit(struct Map map[MAP_WIDTH][MAP_HEIGHT])
{
    for (int x = 0; x < MAP_WIDTH; x++)
    {
        for (int y = 0; y < MAP_HEIGHT; y++)
        {
            map[x][y].health = 0;
            map[x][y].damage = 0;
            map[x][y].defense = 0;
            map[x][y].speed = 0;
            map[x][y].type = 0;
        }
    }
    if(map[0][0].health != 0 || map[3][1].health != 0)
        return 1;
    return 0;
}

int placePlant(struct Map map[MAP_WIDTH][MAP_HEIGHT], uint8_t x, uint8_t y, uint8_t type)
{
    if (x < 0 || x >= MAP_WIDTH || y < 0 || y >= MAP_HEIGHT)
    {
        return 1;
    }
    if (map[x][y].type != 0)
    {
        return 1;
    }
    map[x][y].type = type;
    return 0;
}

int waveSpawn(struct Map map[MAP_WIDTH][MAP_HEIGHT], uint8_t wave)
{
    // spawn enemies based on wave number
    return 0;
}

int updateGame(struct Map map[MAP_WIDTH][MAP_HEIGHT])
{
    // update game state
    return 0;
}

int startGame()
{
    printf("Map Handler Test\n");
    // create a 2D array of Map structs
    struct Map map[MAP_WIDTH][MAP_HEIGHT];

    // initialize the map
    int err = mapinit(map);
    if (err)
    {
        printf("Error initializing map\n");
        return 1;
    }
    printf("Map initialized\n");

    err = gameLoop(map);
    if (err)
    {
        printf("Error %d in game loop\n", err);
        return 1;
    }

    return 0;
}
```

## src/uart.c
```c
#include <string.h>
#include <zephyr/kernel.h>
#include <zephyr/device.h>
#include <zephyr/drivers/uart.h>
#include "uart.h"
#include "main.h"

// Setup uart connection to pc
#define UART_DEVICE_NODE DT_ALIAS(usart)
static const struct device *const uart_dev = DEVICE_DT_GET(UART_DEVICE_NODE);

// Data retrieval
#define MSG_SIZE 128
static char rx_buf[MSG_SIZE];
static int rx_buf_pos;

// Define msgq
K_MSGQ_DEFINE(uart_msgq, MSG_SIZE, 10, 4);

// Needed to read data from uart
void serial_cb(const struct device *dev, void *user_data)
{
	uint8_t c;

	if (!uart_irq_update(uart_dev))
	{
		return;
	}

	if (!uart_irq_rx_ready(uart_dev))
	{
		return;
	}

	// read until FIFO empty
	while (uart_fifo_read(uart_dev, &c, 1) == 1)
	{
		if ((c == '\n' || c == '\r') && rx_buf_pos > 0)
		{
			// terminate string
			rx_buf[rx_buf_pos] = '\0';

			// if queue is full, message is silently dropped
			k_msgq_put(&uart_msgq, &rx_buf, K_NO_WAIT);

			// reset the buffer (it was copied to the msgq)
			rx_buf_pos = 0;
		}
		else if (rx_buf_pos < (sizeof(rx_buf) - 1))
		{
			rx_buf[rx_buf_pos++] = c;
		}
		// else: characters beyond buffer size are dropped
	}
}

// Setup uart device
int uartSetup()
{
	if (!device_is_ready(uart_dev))
	{
		printk("UART device not found!");
		return -1;
	}
	else
	{
		printk("UART device found!");
	}

	/* configure interrupt and callback to receive data */

	int ret = uart_irq_callback_user_data_set(uart_dev, serial_cb, NULL);

	if (ret < 0)
	{
		if (ret == -ENOTSUP)
		{
			printk("Interrupt-driven UART API support not enabled\n");
		}
		else if (ret == -ENOSYS)
		{
			printk("UART device does not support interrupt-driven API\n");
		}
		else
		{
			printk("Error setting UART callback: %d\n", ret);
		}
		return -1;
	}

	uart_irq_rx_enable(uart_dev);
	return 0;
}

// Send uart message
void print_uart(char *buf)
{
	int msg_len = strlen(buf);

	for (int i = 0; i < msg_len; i++)
	{
		uart_poll_out(uart_dev, buf[i]);
	}
	memset(rx_buf, 0, sizeof(rx_buf));
}

// Check message from FPGA
int checkFromFpga()
{
	char Message[MESSAGE_SIZE];
	k_msgq_get(&uart_msgq, &Message, K_NO_WAIT);
	k_msgq_cleanup(&uart_msgq);

	int msg_len = strlen(Message);

	if (msg_len > 3)
	{
		// printf("Input: ");
		// for (int i = 0; i < msg_len; i++)
		// {
		// 	printf("%c", Message[i]);
		// }
		// printf("\n");
	}

	// Returns het bijhorende nummer van het keyword
	if (strstr(Message, "geld"))
	{
		printf("geld selected\n");
		return 0;
	}
	else if (strstr(Message, "bott"))
	{
		printf("bott selected\n");
		return 1;
	}
	else if (strstr(Message, "plan"))
	{
		printf("plan selected\n");
		return 2;
	}
	else if (strstr(Message, "bull"))
	{
		printf("bull selected\n");
		return 3;
	}
	else if (strstr(Message, "life"))
	{
		printf("life selected\n");
		return 4;
	}
	else if (strstr(Message, "sect"))
	{
		printf("sect selected\n");
		return 5;
	}

	return -1;
}
```
